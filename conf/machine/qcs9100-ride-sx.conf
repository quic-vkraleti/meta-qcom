## conf/machine/qcs9100-ride-sx.conf
```bitbake
#@TYPE: Machine
#@NAME: Qualcomm QCS9100 Ride SX Beta Evaluation Kit (EVK)
#@DESCRIPTION: Machine configuration for Qualcomm QCS9100 Ride SX Beta Evaluation Kit (EVK)

require conf/machine/include/qcom-qcs9100.inc

MACHINE_FEATURES += "efi pci"

KERNEL_DEVICETREE ?= " \
                      qcom/qcs9100-ride.dtb \
                      qcom/qcs9100-ride-r3.dtb \
                      qcom/sa8775p-ride.dtb \
                      qcom/sa8775p-ride-r3.dtb \
                      "

MACHINE_ESSENTIAL_EXTRA_RRECOMMENDS += " \
    packagegroup-sa8775p-ride-firmware \
    packagegroup-sa8775p-ride-hexagon-dsp-binaries \
"

#
# Configuration variables for linux-qcom-staging kernel
#

# These addon DTs are not yet upstreamed. Build them only in staging kernel
# to avoid conflicts with other kernel providers like linux-yocto-dev.
KERNEL_DEVICETREE:append:pn-linux-qcom-staging = " \
                      qcom/qcs9100-addons-ride.dtb \
                      qcom/qcs9100-addons-ride-r3.dtb \
                      qcom/sa8775p-addons-ride.dtb \
                      qcom/sa8775p-addons-ride-r3.dtb \
                      "
```
